## conf/layer.conf
```bitbake
# We have a conf and classes directory, add to BBPATH
BBPATH .= ":${LAYERDIR}"

# We have recipes-* directories, add to BBFILES
BBFILES += "${LAYERDIR}/recipes-*/*/*.bb \
            ${LAYERDIR}/recipes-*/*/*.bbappend"

BBFILE_COLLECTIONS += "meta-elastic-beats"
BBFILE_PATTERN_meta-elastic-beats = "^${LAYERDIR}/"
BBFILE_PRIORITY_meta-elastic-beats = "6"

LAYERDEPENDS_meta-elastic-beats = "core"
LAYERSERIES_COMPAT_meta-elastic-beats = "kirkstone langdale mickledore nanbield scarthgap styhead walnascar whinlatter"

BEATS_WHINLATTER_S = "${UNPACKDIR}/${BB_GIT_DEFAULT_DESTSUFFIX}"
BEATS_NON_WHINLATTER_S = "${WORKDIR}/git"

BEATS_S = '${@bb.utils.contains_any("LAYERSERIES_CORENAMES", "whinlatter", d.getVar("BEATS_WHINLATTER_S"), d.getVar("BEATS_NON_WHINLATTER_S"), d)}'
```
